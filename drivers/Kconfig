## drivers/Kconfig
```kconfig
# Copyright (c) 2025 Qingdao IotPi Ltd.
# SPDX-License-Identifier: Apache-2.0

rsource "clock_control/Kconfig"
rsource "pinctrl/Kconfig"
```

## drivers/clock_control/Kconfig
```kconfig
if CLOCK_CONTROL

module = CLOCK_CONTROL
module-str = clock control

rsource "./sf32lb58/Kconfig.sf32lb58"

endif # CLOCK_CONTROL
```
