/*
 * Copyright (c) 2025 Qingdao IotPi Ltd.
 *
 * SPDX-License-Identifier: Apache-2.0
 */

/dts-v1/;
#include <sifli/sf32lb586_n16r32n1_hpsys_hcpu.dtsi>
#include <mem.h>

/ {
    model = "SiFli SF32LB58 DevKit HCPU";
    compatible = "sifli,sf32lb58_devkit_sf32lb586_hcpu";

    chosen {
        zephyr,console = &usart1;
        zephyr,shell-uart = &usart1;
    };
};

&usart1 {
    status = "okay";
};
