## boards/sifli/Kconfig
```kconfig
# Copyright (c) 2025 Qingdao IotPi Ltd.
# SPDX-License-Identifier: Apache-2.0

rsource "em-lb525"
```

## boards/sifli/sf32lb58-devkit/board.yml
```yaml
board:
  name: sf32lb58-devkit
  full_name: SF32LB58 DevKit LCD
  vendor: sifli
  socs:
    - name: sf32lb586
```

## boards/sifli/sf32lb58_devkit/Kconfig.defconfig
```kconfig
# Copyright (c) 2025 Qingdao IotPi Ltd.
#
# SPDX-License-Identifier: Apache-2.0

if BOARD_SF32LB58_DEVKIT
config BOARD
       default "SF32LB58_DEVKIT"
endif
```

## boards/sifli/sf32lb58_devkit/Kconfig.sf32lb58_devkit
```kconfig
# Copyright (c) 2025 Qingdao IotPi Ltd.
#
# SPDX-License-Identifier: Apache-2.0

config BOARD_SF32LB58_DEVKIT
       select SOC_SF32LB586_HCPU if BOARD_SF32LB58_DEVKIT_SF32LB586_HCPU
       select SOC_SF32LB586_ACPU if BOARD_SF32LB58_DEVKIT_SF32LB586_ACPU
       select SOC_SF32LB586_LCPU if BOARD_SF32LB58_DEVKIT_SF32LB586_LCPU
```

## boards/sifli/sf32lb58_devkit/board.yml
```yaml
board:
  name: sf32lb58_devkit
  full_name: SF32LB58 DevKit LCD
  vendor: sifli
  socs:
    - name: sf32lb586
      variants:
      - name: 'hcpu'
        cpucluster: 'hcpu'
```

## boards/sifli/sf32lb58_devkit/sf32lb58_devkit_sf32lb586_hcpu_defconfig
```kconfig
CONFIG_SERIAL=y
CONFIG_CONSOLE=y
CONFIG_UART_CONSOLE=y
CONFIG_CLOCK_CONTROL=y

CONFIG_ARM_MPU=y

CONFIG_HW_STACK_PROTECTION=y
CONFIG_MAIN_STACK_SIZE=2048

CONFIG_SYS_CLOCK_HW_CYCLES_PER_SEC=1000000
```

## drivers/adc/Kconfig
```kconfig
# Copyright (c) 2025, Qingsong Gou <gouqs@hotmail.com>
# SPDX-License-Identifier: Apache-2.0

if ADC

module = ADC
module-str = adc
source "subsys/logging/Kconfig.template.log_config"

rsource "./Kconfig.*"

endif # ADC 
```

## drivers/adc/Kconfig.sf32lb
```kconfig
# Copyright (c) 2025, Qingsong Gou <gouqs@hotmail.com>
# SPDX-License-Identifier: Apache-2.0

config ADC_SF32LB
	bool "ADC driver for SF32LB family of MCUs"
	default y
	depends on ADC
	depends on DT_HAS_SIFLI_ADC_ENABLED
	help
	  Enable ADC driver for SF32LB series of MCUs 
```

## drivers/counter/Kconfig
```kconfig
# Copyright (c) 2025, Qingsong Gou <gouqs@hotmail.com>
# SPDX-License-Identifier: Apache-2.0

if COUNTER

module = COUNTER
module-str = counter
source "subsys/logging/Kconfig.template.log_config"

rsource "./Kconfig.*"

endif # COUNTER 
```

## drivers/counter/Kconfig.sf32lb
```kconfig
# Copyright (c) 2025, Qingsong Gou <gouqs@hotmail.com>
# SPDX-License-Identifier: Apache-2.0

config COUNTER_SF32LB
	bool "Counter driver for SF32LB family of MCUs"
	default y
	depends on COUNTER
	depends on DT_HAS_SIFLI_COUNTER_ENABLED
	help
	  Enable counter driver for SF32LB series of MCUs. This driver uses
	  the LPTIM peripheral to implement the counter functionality. 
```

## drivers/dma/Kconfig
```kconfig
# Copyright (c) 2025, Qingsong Gou <gouqs@hotmail.com>
# SPDX-License-Identifier: Apache-2.0

if DMA

module = DMA
module-str = dma
source "subsys/logging/Kconfig.template.log_config"

rsource "./Kconfig.*"

endif # DMA 
```

## drivers/dma/Kconfig.sf32lb
```kconfig
# Copyright (c) 2025, Qingsong Gou <gouqs@hotmail.com>
# SPDX-License-Identifier: Apache-2.0

config DMA_SF32LB
	bool "DMA driver for SF32LB family of MCUs"
	default y
	depends on DMA
	depends on DT_HAS_SIFLI_DMA_ENABLED
	help
	  Enable DMA driver for SF32LB series of MCUs. This driver provides
	  support for memory-to-memory transfers and peripheral DMA operations. 
```

## drivers/gpio/Kconfig
```kconfig
# Copyright (c) 2023, Quincy.W <wangqyfm@foxmail.com>
# SPDX-License-Identifier: Apache-2.0

if GPIO

module = GPIO
module-str = gpio
source "subsys/logging/Kconfig.template.log_config"

rsource "./Kconfig.*"

endif # GPIO
```

## drivers/pwm/Kconfig.sf32lb
```kconfig
# Copyright (c) 2025, Qingsong Gou <gouqs@hotmail.com>
# SPDX-License-Identifier: Apache-2.0

config PWM_SF32LB
	bool "PWM driver for SF32LB family of MCUs"
	default y
	depends on PWM
	depends on DT_HAS_SIFLI_PWM_ENABLED
	help
	  Enable PWM driver for SF32LB series of MCUs. This driver uses
	  the timer peripheral to implement PWM functionality. 
```

## drivers/serial/Kconfig
```kconfig
# Copyright (c) 2023, Quincy.W <wangqyfm@foxmail.com>
# SPDX-License-Identifier: Apache-2.0

if SERIAL

module = UART
module-str = uart
source "subsys/logging/Kconfig.template.log_config"

rsource "./Kconfig.*"

endif # SERIAL
```

## drivers/spi/Kconfig
```kconfig
# Copyright (c) 2025, Qingsong Gou <gouqs@hotmail.com>
# SPDX-License-Identifier: Apache-2.0

if SPI

module = SPI
module-str = spi
source "subsys/logging/Kconfig.template.log_config"

rsource "./Kconfig.*"

endif # SPI
```

## drivers/spi/Kconfig.sf32lb
```kconfig
# Copyright (c) 2025, Qingsong Gou <gouqs@hotmail.com>
# SPDX-License-Identifier: Apache-2.0

menuconfig SPI_SF32LB
	bool "SPI Driver for SF32LB family of MCUs"
	depends on SPI
	depends on DT_HAS_SIFLI_SPI_ENABLED
	help
	  Enable SPI driver for SF32LB MCUs
```

## drivers/timer/Kconfig
```kconfig
# Copyright (c) 2025, Qingsong Gou <gouqs@hotmail.com>
# SPDX-License-Identifier: Apache-2.0

if TIMER

module = TIMER
module-str = timer
source "subsys/logging/Kconfig.template.log_config"

rsource "./Kconfig.*"

endif # TIMER
```

## drivers/timer/Kconfig.sf32lb
```kconfig
# Copyright (c) 2025, Qingsong Gou <gouqs@hotmail.com>
# SPDX-License-Identifier: Apache-2.0

config TIMER_SF32LB_LPTIM
	bool "LPTIM timer driver for SF32LB family of MCUs"
	default y
	depends on TIMER
	depends on DT_HAS_SIFLI_LPTIM_ENABLED
	help
	  Enable LPTIM timer driver for SF32LB series of MCUs 
```

## drivers/watchdog/Kconfig.sf32lb
```kconfig
config WDT_SF32LB
	bool "SF32LB Low Power Timers"
    default y
    #depends on 
```

## dts/bindings/adc/sifli,adc.yaml
```yaml
description: SiFli SF32LB ADC controller

compatible: "sifli,adc"

include: base.yaml

properties:
  reg:
    required: true

  interrupts:
    required: true
    type: array
    description: |
      ADC interrupt. The interrupt number can be found in the SoC's
      reference manual.

  interrupt-names:
    required: true
    type: array
    items:
      - const: adc

  clocks:
    required: true
    type: array
    description: |
      Clock gate information. The clock gate can be found in the SoC's
      reference manual.

  clock-names:
    required: true
    type: array
    items:
      - const: adc

  resets:
    required: true
    type: array
    description: |
      Reset line information. The reset line can be found in the SoC's
      reference manual.

  reset-names:
    required: true
    type: array
    items:
      - const: adc 
```

## dts/bindings/clock/sifli,rcc.yaml
```yaml
description: SiFli SF32LB Reset and Clock Control (RCC)

compatible: "sifli,rcc"

include: [clock-controller.yaml, base.yaml]

properties:
  reg:
    required: true
    description: RCC register map

  clock-frequency:
    required: true
    type: int

  ahb-prescaler:
    required: true
    type: int

  apb1-prescaler:
    required: true
    type: int

  apb2-prescaler:
    required: true
    type: int

  "#clock-cells":
    const: 2
    description: |
      Number of cells in a clock specifier. The first is offset reg,
      the second is the bit pos

clock-cells:
  - reg
  - bit
```

## dts/bindings/clock/sifli,sf32lb-clock.yaml
```yaml
# Copyright (c) 2025 Qingdao IotPi Ltd.
#
# SPDX-License-Identifier: Apache-2.0


description: |
  Sifli SF32xxx Reset and Clock Controller

compatible: "sifli,sf32lb-clock"

include: [clock-controller.yaml, base.yaml]

properties:
  reg:
    required: true
    description: register address map

  # clock-configs:
  #   required: true
  #   type: phandle-array
  #   description: |
  #     clock configs are used to specify configuration of the
  #     SoC clock DIV fields. Such as PDIV1 PDIV2 fields in
  #     CFGR register of HPSYS_RCC. For example:
  #       clock-configs = <PDIV1 2>, <PDIV2 3>;

  "#clock-cells":
    const: 0

  # "#clock-config-cells":
  #   type: int
  #   required: true
  #   const: 2
```

## dts/bindings/rtc/sifli,rtc.yaml
```yaml
description: SiFli SF32LB RTC controller

compatible: "sifli,rtc"

include: base.yaml

properties:
  reg:
    required: true

  interrupts:
    required: true
    type: array
    description: |
      RTC interrupt. The interrupt number can be found in the SoC's
      reference manual.
```

## dts/bindings/timer/sifli,lptim.yaml
```yaml
description: SiFli SF32LB Low Power Timer (LPTIM)

compatible: "sifli,lptim"

include: base.yaml

properties:
  reg:
    required: true
```
