/*
 * Copyright (c) 2025 Qingdao IotPi Ltd.
 *
 * SPDX-License-Identifier: Apache-2.0
 */

#include <arm/armv8-m.dtsi>
#include <sifli/sf32lb58_hpsys.dtsi>
#include <mem.h>

/ {
    chosen {
		zephyr,sram = &sram_hcpu;
    };

    cpus {
		#address-cells = <1>;
		#size-cells = <0>;

		hcpu: cpu@0 {
			device_type = "cpu";
			compatible = "arm,cortex-m33f";
			reg = <0>;
			// cpu-power-states = <&stop0 &stop1 &stop2>;
		};
    };
};
