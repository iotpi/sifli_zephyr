## modules/Kconfig.sf32lb
```kconfig
# Copyright (c) 2025 Qingdao IotPi Ltd.
# SPDX-License-Identifier: Apache-2.0

config HAS_SIFLISDK
	bool
	depends on SOC_FAMILY_SF32LB
```

## soc/sifli/Kconfig.soc
```kconfig
# SiFli SF32LB all MCU lines
# SPDX-License-Identifier: Apache-2.0

config SOC_FAMILY_SF32LB
	bool

#config CODE_DATA_RELOCATION_SRAM
#    bool
#    default y

config SOC_FAMILY
	default "sf32lb" if SOC_FAMILY_SF32LB

rsource "*/Kconfig.soc"
```

## soc/sifli/sf32lb58/Kconfig
```kconfig
# Copyright (c) 2025 Qingdao IotPi Ltd.
#
# SPDX-License-Identifier: Apache-2.0

config SOC_SERIES_SF32LB58
       bool
       select ARM
       select CPU_CORTEX_M33
       select CPU_HAS_ARM_MPU
```

## soc/sifli/sf32lb58/Kconfig.defconfig
```kconfig
if SOC_SERIES_SF32LB58

rsource "Kconfig.defconfig.*"

endif # SOC_SERIES_SF32LB58
```
